/****************************************************************************************
         CPET253 Lab6 - Bump Sensors and Interrupts

 Jeanne Christman
 original version 1/7/2024

 This program uses hardware interrupts generated by the bump sensors and a state machine 
 to control the TI-RSLK robot as follows:
  - Starts by moving forward and continues forward until collision is detect. 
  - Once collision is detected, go backward for about a half of a second. 
  - Turn the direction opposite of the detected bump.  If the collision was a right side collision, 
    turn left. If the collision was on the left side, turn right.
  - Continue forward until a new collision is detected. 


The active-low bump sensors are connected to Port4 pins 0, 2, 3, 4, 5 & 6. All 6 pins are configured
as interrupt sources.

 Functions in this code:
     -Clock_Init48MHz() - function provided by TI to set system clock
     -Clock_Delay1ms(time) - built in function that delays time ms
     -EnableInterrupts() - built in function to enable global interrupts
     -Port2_Init();
     -Port3_Init();
     -Port4_Init();
     -Port5_Init();
     -TimerA0_Init();
     -BumpInt_Init();
     -Motor_Forward(volatile uint16_t rightDuty, volatile uint16_t leftDuty );
     -Motor_Backward(volatile uint16_t rightDuty, volatile uint16_t leftDuty );
     -Motor_Right(volatile uint16_t rightDuty, volatile uint16_t leftDuty );
     -Motor_Left(volatile uint16_t rightDuty, volatile uint16_t leftDuty );

The state machine has 4 states; forward, right, left, backward
*******************************************************************************************/

#include "msp.h"
#include <stdint.h>
#include <stdbool.h>
#include "..\inc\Clock.h"
#include "..\inc\CortexM.h"
#include "..\inc\Init_Ports.h"
#include "..\inc\motor.h"
#include "..\inc\Init_Timers.h"
#include "..\inc\BumpInt.h"

//Declare constants for colored LED
//The LED is controlled by P2.0(red), P2.1(green) and P2.2(blue)
#define RED BIT0
#define GREEN BIT1
#define BLUE BIT2
#define PURPLE BIT0 | BIT2

//optional function
     void LED_Color (uint8_t color) {
     //This is a simple function to turn on the multi-colored LED on the MSP432 Launchpad
     //board according to the argument passed into the function
     //The LED is controlled by bits 0, 1 and 2 on PORT2
         P2OUT &= ~BIT0 & ~BIT1 & ~BIT2;   //first turn off all colors
         P2OUT |= color;                   //second turn on the input color
     }

     extern uint8_t LeftBump, RightBump;  //variables from the ISR to indicate on which side the bump occured

void main(void)
{
       WDT_A->CTL = WDT_A_CTL_PW | WDT_A_CTL_HOLD;     // stop watchdog timer
       Clock_Init48MHz();  // makes bus clock 48 MHz
       //Call the appropriate functions from Init_Ports.c
       Port2_Init();
       Port3_Init();
       Port4_Init();
       Port5_Init();
       //Call the appropriate functions from Init_Timers.c
       TimerA0_Init();
       //call the appropriate functions from Bumpint
       BumpInt_Init();
       EnableInterrupts(); //enable global interrupts
       //These are the four states of the state machine
             enum direction_states {Forward, Right, Left, Backward} state, prevState;

             state = Forward;                   //start state
             prevState = Right;                 //used to know when the state has changed
             uint16_t stateTimer;              //used to stay in a state
             bool isNewState;                  //true when the state has switched

             while(1)
             {
                 isNewState = (state != prevState);
                 prevState = state;  //save state for next time

                switch (state) {
                //each case below should have entry housekeeping, state business and exit housekeeping
                //remember to reset the stateTimer and (optionally) turn on the LED each time you enter a new state
                //you must assign a new state when stateTimer reaches the correct value
                case Forward:
                    if (isNewState) {
                        stateTimer = 0;
                        LED_Color(GREEN);
                        Motor_Forward(14999,14999);
                    }
                    if (LeftBump || RightBump) {   //if there is a collision, go backward
                        state = Backward;
                    }
                    break;
                case Right:
                    if (isNewState) {
                        stateTimer = 0;
                        LED_Color(RED);
                        Motor_Right(0,14999);
                    }
                    stateTimer++;
                    if (stateTimer >= 75) {
                        state = Forward;
                    }
                    break;
                case Backward:
                    if (isNewState) {
                        stateTimer = 0;
                        LED_Color(BLUE);
                        Motor_Backward(14999,14999);
                    }
                    stateTimer++;
                    if ((stateTimer >= 100) && (LeftBump)) {
                        state = Right;
                        LeftBump = 0;
                    }
                    if ((stateTimer >= 100) && (RightBump)) {
                        state = Left;
                        RightBump = 0;
                    }
                    break;
                case Left:
                    if (isNewState) {
                        stateTimer = 0;
                        LED_Color(PURPLE);
                        Motor_Left(14999,0);
                    }
                    stateTimer++;
                    if (stateTimer >= 75) {
                        state = Forward;
                    }
                    break;
                } //switch
                Clock_Delay1ms(10);  //10ms delay so that each increment of statetimer is 10ms
             } //while(1)
         } //main()
